## boards/arm/bst_ab3_nrf52840/Kconfig
```kconfig
# BST-AB3-NRF52840 board configuration

# Copyright (c) 2022 Bosch Sensortec GmbH
# SPDX-License-Identifier: Apache-2.0

config BOARD_ENABLE_DCDC
	bool "Enable DCDC mode"
	select SOC_DCDC_NRF52X
	default y
	depends on BOARD_BST_AB3_NRF52840
```

## boards/arm/bst_ab3_nrf52840/Kconfig.board
```kconfig
# BST-AB3 board configuration

# Copyright (c)2022 Bosch Sensortec GmbH
# SPDX-License-Identifier: Apache-2.0

config BOARD_BST_AB3_NRF52840
	bool "bst AB3"
	depends on SOC_NRF52840_QIAA

#Bosch Sensortec Application Board 3.0 can be configured for supplying
#the sensor shuttle board 1.8V or 2.8 V. The following board-specific
#config option can be used to set VDD to 2.8 V in board.c
config BST_AB3_NRF52840_SELECT_VDD_2_8
	bool "BST_AB3_NRF52840 Select VDD 2.8V"
	depends on BOARD_BST_AB3_NRF52840
```

## boards/arm/bst_ab3_nrf52840/Kconfig.defconfig
```kconfig
# BST-AB3 board configuration

# Copyright (c) 2022 Bosch Sensortec GmbH
# SPDX-License-Identifier: Apache-2.0

if BOARD_BST_AB3_NRF52840

config BOARD
	default "bst_ab3_nrf52840"

#Flash load offset is given as 0x30000 to avoid the NS Softdevice S140 with 
#Bluetooth Stack and USB MTP Firmware which come pre-flashed on the board
#Refer the flash section in bst_ab3_nrf52840.dts file for more details
config FLASH_LOAD_OFFSET
	default 0x30000

#Bosch Sensortec Application Board 3.0 can be configured for supplying
#the sensor shuttle board 1.8V or 2.8 V. The following board-specific
#config option can be used to set VDD to 2.8 V in board.c Default is
#1.8 V. The setting can be changed here for all applications or 
#overridden for specific applications in the app prj.conf file
config BST_AB3_NRF52840_SELECT_VDD_2_8
	default n
	
if USB_DEVICE_STACK

config UART_LINE_CTRL
	default y

endif # USB_DEVICE_STACK

config IEEE802154_NRF5
	default y
	depends on IEEE802154

config BT_CTLR
	default BT

endif # BOARD_BST_AB3_NRF52840
```

## boards/arm/bst_ab3_nrf52840/bst_ab3_nrf52840_defconfig
```kconfig
# BST-AB3-NRF52840 board configuration

# Copyright (c) 2022 Bosch Sensortec GmbH
# SPDX-License-Identifier: Apache-2.0

CONFIG_SOC_SERIES_NRF52X=y
CONFIG_SOC_NRF52840_QIAA=y
CONFIG_BOARD_BST_AB3_NRF52840=y

# Enable MPU
CONFIG_ARM_MPU=y

# Enable hardware stack protection
CONFIG_HW_STACK_PROTECTION=y

#Enable Segger RTT Console
CONFIG_USE_SEGGER_RTT=y


# enable GPIO
CONFIG_GPIO=y

# settings to enable USB console
CONFIG_USB_DEVICE_STACK=y
CONFIG_SERIAL=y
CONFIG_CONSOLE=y
CONFIG_UART_CONSOLE=y
CONFIG_UART_LINE_CTRL=y

# additional board options
CONFIG_GPIO_AS_PINRESET=y
```
